## Kconfig
```kconfig
#
# Copyright 2014, NICTA
#
# This software may be distributed and modified according to the terms of
# the BSD 2-Clause license. Note that NO WARRANTY is provided.
# See "LICENSE_BSD2.txt" for details.
#
# @TAG(NICTA_BSD)
#

mainmenu "Project Configuration"

config COMMON_PATH
    string
    option env="COMMON_PATH"

menu "seL4 Kernel"
    source "kernel/Kconfig"
endmenu

menu "seL4 Libraries"
    source "libs/libmuslc/Kconfig"
    source "libs/libsel4/Kconfig"
    source "libs/libsel4cspace/Kconfig"
    source "libs/liblwip/Kconfig"
    source "libs/libserial/Kconfig"
    source "libs/libnfs/Kconfig"
    source "libs/libclock/Kconfig"
    source "libs/libelf/Kconfig"
    source "libs/libcpio/Kconfig"
    source "libs/libethdrivers/Kconfig"
    source "libs/libutils/Kconfig"
    source "libs/libplatsupport/Kconfig"
    source "libs/libsos/Kconfig"
    source "libs/libsel4sync/Kconfig"
endmenu

menu "seL4 Applications"
    source "apps/sos/Kconfig"
    source "apps/sosh/Kconfig"
    source "apps/tty_test/Kconfig"
endmenu

menu "Tools"
    source "tools/elfloader/Kconfig"
endmenu

source "$COMMON_PATH/Kconfig"
```

## apps/sos/Kconfig
```kconfig
#
# Copyright 2014, NICTA
#
# This software may be distributed and modified according to the terms of
# the BSD 2-Clause license. Note that NO WARRANTY is provided.
# See "LICENSE_BSD2.txt" for details.
#
# @TAG(NICTA_BSD)
#

menuconfig APP_SOS
    bool "SeL4 Simple Operating System (SOS)"
    select LIB_SEL4 
    select LIB_MUSL_C
    select LIB_ELF
    select LIB_CPIO
    select LIB_SEL4_CSPACE 
    select LIB_IXP400_XSCALE_SW if IXP400
    select LIB_IXP_OSAL if IXP400
    select LIB_ETHIF
    select LIB_LWIP 
    select LIB_NFS 
    select LIB_SERIAL 
    select LIB_CLOCK
    select LIB_SOS
    select LIB_PLATSUPPORT
    default y
    help
        Simple Operating System (aka AOS implementation)

config SOS_NETMASK
    string "Network mask"
    depends on APP_SOS
    default "225.225.225.0"

config SOS_IP
    string "IP address"
    depends on APP_SOS
    default "192.168.168.2"

config SOS_GATEWAY
    string "Gateway IP address"
    depends on APP_SOS
    default "192.168.168.1"

config SOS_NFS_DIR
    string "NFS directory"
    depends on APP_SOS
    default "/var/tftpboot/USER"

config SOS_STARTUP_APP
    string "Startup application name"
    depends on APP_SOS
    default "tty_test"
```

## apps/sosh/Kconfig
```kconfig
#
# Copyright 2014, NICTA
#
# This software may be distributed and modified according to the terms of
# the BSD 2-Clause license. Note that NO WARRANTY is provided.
# See "LICENSE_BSD2.txt" for details.
#
# @TAG(NICTA_BSD)
#

config APP_SOSH
    bool "SOSH"
    depends on LIB_SEL4 && HAVE_LIBC && LIB_SOS
    default n
    select HAVE_SEL4_APPS
    help
        Simple shell built upon the Simple Operating System
```

## apps/tty_test/Kconfig
```kconfig
#
# Copyright 2014, NICTA
#
# This software may be distributed and modified according to the terms of
# the BSD 2-Clause license. Note that NO WARRANTY is provided.
# See "LICENSE_BSD2.txt" for details.
#
# @TAG(NICTA_BSD)
#

config APP_TTY_TEST
    bool "TTY test"
    depends on LIB_SEL4 && HAVE_LIBC && LIB_SOS
    default y
    select HAVE_SEL4_APPS
    help
        A test program for printing over serial for AOS
```

## libclock/Kconfig
```kconfig
#
# Copyright 2014, NICTA
#
# This software may be distributed and modified according to the terms of
# the BSD 2-Clause license. Note that NO WARRANTY is provided.
# See "LICENSE_BSD2.txt" for details.
#
# @TAG(NICTA_BSD)
#

config LIB_CLOCK
    bool "Build libclock"
    select LIB_SEL4 
    select LIB_SEL4_C
    select HAVE_SEL4_LIBS
    default y
    help
        "Basic clock interfaces for seL4 sos"
```

## libsel4cspace/Kconfig
```kconfig
#
# Copyright 2018, Data61
# Commonwealth Scientific and Industrial Research Organisation (CSIRO)
# ABN 41 687 119 230.
#
# This software may be distributed and modified according to the terms of
# the BSD 2-Clause license. Note that NO WARRANTY is provided.
# See "LICENSE_BSD2.txt" for details.
#
# @TAG(DATA61_BSD)
#
config LIB_SEL4_CSPACE
    bool "Build sel4cspace"
    select LIB_SEL4 
    select LIB_SEL4_C
    select HAVE_SEL4_LIBS
    default y
    help
        "A simpe CSpace manager for seL4"
```

## libsos/Kconfig
```kconfig
#
# Copyright 2014, NICTA
#
# This software may be distributed and modified according to the terms of
# the BSD 2-Clause license. Note that NO WARRANTY is provided.
# See "LICENSE_BSD2.txt" for details.
#
# @TAG(NICTA_BSD)
#

config LIB_SOS
    bool "Build sos library"
    select HAVE_SEL4_LIBS
    select LIB_UTILS
    default y
    help
        "C platform dependant function implementations for sos clients"
```
